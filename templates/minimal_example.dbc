VERSION ""

NS_ :

BS_:

BU_: DBG

BO_ 291 ExampleMsg: 8 DBG
 SG_ AliveCounter : 0|8@1+ (1,0) [0|255] "" DBG
